## board/kmtek/stm32mp157c_kmtek_octavo/Kconfig
```kconfig
if TARGET_STM32MP157C_KMTEK_OCTAVO

config SYS_BOARD
	default "stm32mp157c_kmtek_octavo"

config SYS_VENDOR
	default "kmtek"

config SYS_CONFIG_NAME
	default "stm32mp1"

config ENV_SECT_SIZE
	default 0x10000 if ENV_IS_IN_SPI_FLASH

config ENV_OFFSET
	default 0x1E0000 if ENV_IS_IN_SPI_FLASH

config ENV_OFFSET_REDUND
	default 0x1F0000 if ENV_IS_IN_SPI_FLASH

source "board/st/common/Kconfig"
endif
```
